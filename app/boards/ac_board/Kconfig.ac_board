## app/boards/ac_board/board.yml
```yaml
board:
  name: ac_board
  full_name: AC Board
  vendor: ac
  socs:
  # Physical nRF52840 SoC on PCA10056
  - name: nrf52840
```

## app/boards/jz_board/board.yml
```yaml
board:
  name: jz_board
  full_name: JZ Board
  vendor: jz
  socs:
  # Physical nRF52840 SoC on PCA10056
  - name: nrf52840
```

## app/drivers/sensor/led_sensor/Kconfig
```kconfig
config LED_SENSOR
    bool "LED sensor driver"
    default y
    depends on GPIO
    depends on SENSOR
    help
        Enable custom LED sensor driver.
```

## twister-out/native_sim_native/host/homework.unit.ring_buf/Kconfig/arch/Kconfig
```kconfig
# Load Zephyr Arch Kconfig descriptions.
osource "/home/jcalixto/Documents/zephyr-training/deps/zephyr/arch/rx/Kconfig"
osource "/home/jcalixto/Documents/zephyr-training/deps/zephyr/arch/x86/Kconfig"
osource "/home/jcalixto/Documents/zephyr-training/deps/zephyr/arch/xtensa/Kconfig"
osource "/home/jcalixto/Documents/zephyr-training/deps/zephyr/arch/sparc/Kconfig"
osource "/home/jcalixto/Documents/zephyr-training/deps/zephyr/arch/riscv/Kconfig"
osource "/home/jcalixto/Documents/zephyr-training/deps/zephyr/arch/posix/Kconfig"
osource "/home/jcalixto/Documents/zephyr-training/deps/zephyr/arch/mips/Kconfig"
osource "/home/jcalixto/Documents/zephyr-training/deps/zephyr/arch/arm64/Kconfig"
osource "/home/jcalixto/Documents/zephyr-training/deps/zephyr/arch/arm/Kconfig"
osource "/home/jcalixto/Documents/zephyr-training/deps/zephyr/arch/arc/Kconfig"
```

## twister-out/native_sim_native/host/homework.unit.ring_buf/Kconfig/boards/Kconfig
```kconfig
# Load Zephyr board Kconfig descriptions.
osource "/home/jcalixto/Documents/zephyr-training/deps/zephyr/boards/native/native_sim/Kconfig"
```

## twister-out/native_sim_native/host/homework.unit.ring_buf/Kconfig/boards/Kconfig.defconfig
```kconfig
# Load Zephyr board defconfig descriptions.
osource "/home/jcalixto/Documents/zephyr-training/deps/zephyr/boards/native/native_sim/Kconfig.defconfig"
```

## twister-out/native_sim_native/host/homework.unit.ring_buf/Kconfig/boards/Kconfig.native_sim
```kconfig
# Load board Kconfig descriptions.
osource "/home/jcalixto/Documents/zephyr-training/deps/zephyr/boards/native/native_sim/Kconfig.native_sim"
```

## twister-out/native_sim_native/host/homework.unit.ring_buf/Kconfig/boards/Kconfig.sysbuild
```kconfig
# Load Sysbuild board Kconfig descriptions.
osource "/home/jcalixto/Documents/zephyr-training/deps/zephyr/boards/native/native_sim/Kconfig.sysbuild"
```
